// Copyright 2022 Manna Harbour
// https://github.com/manna-harbour/miryoku

&mmv {
  acceleration-exponent = <U_MOUSE_MOVE_EXPONENT>;
  time-to-max-speed-ms = <U_MOUSE_MOVE_TIME>;
  delay-ms = <U_MOUSE_MOVE_DELAY>;
};

// Enabled (upstream ships this commented out, so scroll silently inherited
// mouse_scroll.dtsi's stock 300ms/exponent-0 rather than the U_MOUSE_SCROLL_*
// values above).
&msc {
  acceleration-exponent = <U_MOUSE_SCROLL_EXPONENT>;
  time-to-max-speed-ms = <U_MOUSE_SCROLL_TIME>;
  delay-ms = <U_MOUSE_SCROLL_DELAY>;
};
